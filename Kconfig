## boards/shields/cornix_dongle/Kconfig.defconfig
```kconfig
if SHIELD_CORNIX_DONGLE

config ZMK_SPLIT
    default y

config ZMK_KEYBOARD_NAME
    default "Cornix"

config ZMK_SPLIT_ROLE_CENTRAL
    default y

config ZMK_USB
	default y

endif
```

## boards/shields/cornix_dongle/Kconfig.shield
```kconfig
source "Kconfig.generated"

config SHIELD_CORNIX_DONGLE
	def_bool $(shields_list_contains,cornix_dongle)

rsource "$(shields_dir)/dongle_display/Kconfig"
```

## config/boards/shields/cornix/Kconfig.defconfig
```kconfig
if SHIELD_CALDERA_DONGLE
    config CONFIG_DONGLE_SCREEN_AMBIENT_LIGHT 
        default y
endif
```

## config/west.yml
```yaml
manifest:
  remotes:
    - name: zmkfirmware
      url-base: https://github.com/zmkfirmware
    - name: cornix-shield
      url-base: https://github.com/hitsmaxft
    - name: urob
      url-base: https://github.com/urob
  projects:
    - name: zmk
      remote: zmkfirmware
      import: app/west.yml
      revision: 641514a97db345f499dd50b0360e594270f008fe
    # Override ZMK's floating v4.1.0+zmk-fixes branch with the exact
    # controller revision from successful build 33939327936.
    - name: zephyr
      remote: zmkfirmware
      revision: 10ba6d0cb38bc3d258775d27982f707599320085
      clone-depth: 1
      import:
        name-blocklist:
          - ci-tools
          - hal_altera
          - hal_cypress
          - hal_infineon
          - hal_microchip
          - hal_nxp
          - hal_openisa
          - hal_xtensa
          - hal_st
          - hal_ti
          - loramac-node
          - mcuboot
          - mcumgr
          - net-tools
          - openthread
          - edtt
          - trusted-firmware-m
    - name: zmk-keyboard-cornix
      remote: cornix-shield
      revision: b2d5712fa3ef43ccbb796d3df1d48b78d59d27df
    - name: zmk-helpers
      remote: urob
      revision: 95edb8f15ef1d1bd8332810555f8cf5837fbdd27
  self:
    path: config
```
